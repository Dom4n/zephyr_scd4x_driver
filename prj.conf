## CMakeLists.txt
```
cmake_minimum_required(VERSION 3.20.0)
find_package(Zephyr REQUIRED HINTS $ENV{ZEPHYR_BASE})

project(sdc40)

target_sources(app PRIVATE src/main.c)
target_sources(app PRIVATE src/scd4x.c)
```

## prj.conf
```kconfig
CONFIG_I2C=y
CONFIG_SENSOR=y
CONFIG_SERIAL=y

CONFIG_CONSOLE=y
CONFIG_UART_CONSOLE=y
CONFIG_STDOUT_CONSOLE=y

# CONFIG_RTT_CONSOLE=y
# Enable RTT
CONFIG_USE_SEGGER_RTT=y
CONFIG_LOG=y
# CONFIG_LOG_BACKEND_RTT=y
CONFIG_LOG_BACKEND_UART=y
CONFIG_LOG_PRINTK=y

CONFIG_CRC=y
```

## src/main.c
```c
#include <zephyr/kernel.h>

#include <zephyr/device.h>
#include <zephyr/kernel.h>
#include <zephyr/drivers/sensor.h>
#include <zephyr/logging/log.h>
#include <zephyr/pm/device.h>
#include <zephyr/sys/printk.h>

#include "scd4x.h"

const struct device *i2c_dev = DEVICE_DT_GET(DT_NODELABEL(i2c0));


int main(void)
{
        k_msleep(1000);
        printk("Starting application\n");

        if (i2c_dev == NULL) {
                printk("I2C device not found\n");
                return -1;
        }
        if (!device_is_ready(i2c_dev)) {
                printk("I2C device not ready\n");
                return -1;
        }

        printk("I2C device %s - %p is ready\n", i2c_dev->name, i2c_dev);

        int ret = scd4x_get_serial_number(i2c_dev);
        if (ret < 0) {
                printk("sdc40_get_serial_number failed\n");
        }

        ret = scd4x_start_periodic_measurement(i2c_dev);
        // k_msleep(5000);  // wait 5s until first measurement is ready

        while (1) {
                ret = scd4x_read_measurement(i2c_dev);
                if (ret < 0) {
                        printk("sdc40_read_measurement failed\n");
                }
                k_msleep(5000);
        }
        return 0;
}
```

## src/scd4x.c
```c
#include <zephyr/kernel.h>
#include <zephyr/drivers/i2c.h>
#include <zephyr/sys/byteorder.h>
#include <zephyr/sys/crc.h>

#include "scd4x.h"

uint8_t scd4x_compute_crc(uint16_t value)
{
        uint8_t buf[2];

        sys_put_be16(value, buf);

        return crc8(buf, 2, SCD4X_CRC8_POLY, SCD4X_CRC8_INIT, false);
}

int scd4x_write_command(const struct device *dev, uint16_t cmd)
{
        uint8_t tx_buf[2];
        sys_put_be16(cmd, tx_buf);

        return i2c_write(dev, tx_buf, sizeof(tx_buf), SCD4X_I2C_ADDRESS);;
}

int scd4x_get_data_ready_status(const struct device *dev)
{
        int ret;
        uint8_t rx_buf[3];
        uint8_t tx_buf[2];
        sys_put_be16(SCD4X_GET_DATA_READY_STATUS, tx_buf);

        ret = scd4x_write_command(dev, SCD4X_GET_DATA_READY_STATUS);
        if (ret < 0) {
                printk("Failed to request data ready status\n");
                printk("Error: %d\n", ret);
                return ret;
        }
        k_msleep(1);
        
        ret = i2c_read(dev, rx_buf, sizeof(rx_buf), SCD4X_I2C_ADDRESS);
        if (ret < 0) {
                printk("Failed to read data ready status\n");
                printk("Error: %d\n", ret);
                return ret;
        }

        uint16_t data_ready = (rx_buf[0] << 8) | rx_buf[1];
        uint8_t crc = scd4x_compute_crc(data_ready);
        if (crc != rx_buf[2]) {
                printk("CRC check failed\n");
                return -1;
        }

        // If the least significant 11 bits of word[0] are 0 then the data is not ready, else it is ready
        if (data_ready & 0x7FF) {
                // printk("Data is ready\n");
                return 1;
        } else {
                // printk("Data is not ready\n");
                return 0;
        }

        return data_ready;
}

int scd4x_get_serial_number(const struct device *dev)
{
        int ret;
        uint8_t rx_buf[9];
        uint8_t tx_buf[2];
        sys_put_be16(SCD4X_GET_SERIAL_NUMBER, tx_buf);
        
        // ret = i2c_write(dev, tx_buf, sizeof(tx_buf), SCD4X_I2C_ADDRESS);
        ret = scd4x_write_command(dev, SCD4X_GET_SERIAL_NUMBER);
        if (ret < 0) {
                printk("Failed to request serial number\n");
                printk("Error: %d\n", ret);
                return ret;
        }
        k_msleep(1);
        
        ret = i2c_read(dev, rx_buf, sizeof(rx_buf), SCD4X_I2C_ADDRESS);
        if (ret < 0) {
                printk("Failed to read serial number\n");
                printk("Error: %d\n", ret);
                return ret;
        }
        
        uint16_t serial_number[3];
        serial_number[0] = (rx_buf[0] << 8) | rx_buf[1];
        serial_number[1] = (rx_buf[3] << 8) | rx_buf[4];
        serial_number[2] = (rx_buf[6] << 8) | rx_buf[7];
        // print serial number as 48bit number
        printk("Serial number: %d%d%d\n", serial_number[0], serial_number[1], serial_number[2]);
        // check crc
        uint8_t crc[3] = {scd4x_compute_crc(serial_number[0]), scd4x_compute_crc(serial_number[1]), scd4x_compute_crc(serial_number[2])};
        if (crc[0] != rx_buf[2] || crc[1] != rx_buf[5] || crc[2] != rx_buf[8]) {
                printk("CRC check failed\n");
                return -1;
        }

        return 0;
}

int scd4x_start_periodic_measurement(const struct device *dev)
{
        int ret;

        ret = scd4x_write_command(dev, SCD4X_START_PERIODIC_MEASUREMENT);
        if (ret < 0) {
                printk("Failed to start periodic measurement\n");
                printk("Error: %d\n", ret);
                return ret;
        }
        
        return 0;

}

int scd4x_read_measurement(const struct device *dev)
{
        int ret;
        uint8_t rx_buf[9];
        uint8_t tx_buf[2];
        sys_put_be16(SCD4X_READ_MEASUREMENT, tx_buf);

        // first check if data is ready
        ret = scd4x_get_data_ready_status(dev);
        if (ret < 0) {
                printk("Failed to get data ready status\n");
                printk("Error: %d\n", ret);
                return ret;
        }
        if (ret == 0) {
                printk("Data is not ready\n");
                return 0;
        }

        ret = scd4x_write_command(dev, SCD4X_READ_MEASUREMENT);
        if (ret < 0) {
                printk("Failed to request measurement\n");
                printk("Error: %d\n", ret);
                return ret;
        }
        k_msleep(1);
        
        ret = i2c_read(dev, rx_buf, sizeof(rx_buf), SCD4X_I2C_ADDRESS);
        if (ret < 0) {
                printk("Failed to read measurement\n");
                printk("Error: %d\n", ret);
                return ret;
        }

        // rx_buf explanation:
        // - first 2 bytes are CO2, 1 byte crc
        // - next 2 bytes are temperature, needs convertion T = -45 + 175 * (T_raw / (2^16 -1)), 1 byte crc
        // - last 2 bytes are relative humidity, needs convertion RH = 100 * (RH_raw / (2^16 -1), 1 byte crc
        int16_t co2_raw = (rx_buf[0] << 8) | rx_buf[1];
        int16_t temp_raw = (rx_buf[3] << 8) | rx_buf[4];
        int16_t rh_raw = (rx_buf[6] << 8) | rx_buf[7];

        uint8_t temp = -45 + ( 175 * temp_raw / 0xFFFF);
        uint8_t rh = 100 * rh_raw / 0xFFFF;


        printk("Measurement: CO2: %d, Temp: %d, RH: %d\n", co2_raw, temp, rh);

        uint8_t crc_computed_co2 = scd4x_compute_crc(co2_raw);
        uint8_t crc_computed_temp = scd4x_compute_crc(temp_raw);
        uint8_t crc_computed_rh = scd4x_compute_crc(rh_raw);
        // printk("crc computed: %02x %02x %02x\n", crc_computed_co2, crc_computed_temp, crc_computed_rh);
        if (crc_computed_co2 != rx_buf[2] || crc_computed_temp != rx_buf[5] || crc_computed_rh != rx_buf[8]) {
                printk("CRC check failed\n");
                return -1;
        }
        
        return 0;
}
```

## src/scd4x.h
```c
#define SCD4X_I2C_ADDRESS 0x62

// Basic commands
#define SCD4X_START_PERIODIC_MEASUREMENT 0x21b1 // send command, exec. time: -, during meas.: no
#define SCD4X_READ_MEASUREMENT 0xec05 // read, exec. time: 1ms, during meas.: yes
#define SCD4X_STOP_PERIODIC_MEASUREMENT 0x3f86 // send command, exec. time: 500ms, during meas.: yes

// On-chip output signal compensation
#define SCD4X_SET_TEMPERATURE_OFFSET 0x241d // write, exec. time: 1ms, during meas.: no
#define SCD4X_GET_TEMPERATURE_OFFSET 0x2318 // read, exec. time: 1ms, during meas.: no
#define SCD4X_SET_SENSOR_ALTITUDE 0x2427 // write, exec. time: 1ms, during meas.: no
#define SCD4X_GET_SENSOR_ALTITUDE 0x2322 // read, exec. time: 1ms, during meas.: no
#define SCD4X_SET_AMBIENT_PRESSURE 0xe000 // write, exec. time: 1ms, during meas.: yes
#define SCD4X_GET_AMBIENT_PRESSURE 0xe000 // read, exec. time: 1ms, during meas.: yes

// Field calibration
#define SCD4X_PERFORM_FORCED_RECALIBRATION 0x362f // send command and fetch result, exec. time: 400ms, during meas.: no
#define SCD4X_SET_AUTOMATIC_SELF_CALIBRATION_ENABLED 0x2416 // write, exec. time: 1ms, during meas.: no
#define SCD4X_GET_AUTOMATIC_SELF_CALIBRATION_ENABLED 0x2313 // read, exec. time: 1ms, during meas.: no

// Low power periodic measurement mode
#define SCD4X_START_LOW_POWER_PERIODIC_MEASUREMENT 0x21ac // send command, exec. time: -, during meas.: no
#define SCD4X_GET_DATA_READY_STATUS 0xe4b8 // read, exec. time: 1ms, during meas.: yes

// Advanced features
#define SCD4X_PERSIST_SETTINGS 0x3615 // send command, exec. time: 800ms, during meas.: no
#define SCD4X_GET_SERIAL_NUMBER 0x3682 // read, exec. time: 1ms, during meas.: no
#define SCD4X_PERFORM_SELF_TEST 0x3639 // read, exec. time: 10000ms, during meas.: no
#define SCD4X_PERFORM_FACTORY_RESET 0x3632 // send command, exec. time: 1200ms, during meas.: no
#define SCD4X_REINIT 0x3646 // send command, exec. time: 20ms, during meas.: no

// Signle shot measurement mode (SCD41 only)
#define SCD41_MEASURE_SINGLE_SHOT 0x219d // send command, exec. time: 5000ms, during meas.: no
#define SCD41_MEASURE_SINGLE_SHOT_RHT_ONLY 0x2196 // send command, exec. time: 50ms, during meas.: no
#define SCD41_POWER_DOWN 0x36e0 // send command, exec. time: 1ms, during meas.: no
#define SCD41_WAKE_UP 0x36f6 // send command, exec. time: 20ms, during meas.: no
#define SCD41_SET_AUTOMATIC_SELF_CALIBRATION_INITIAL_PERIOD 0x2445 // write, exec. time: 1ms, during meas.: no
#define SCD41_GET_AUTOMATIC_SELF_CALIBRATION_INITIAL_PERIOD 0x2340 // read, exec. time: 1ms, during meas.: no
#define SCD41_SET_AUTOMATIC_SELF_CALIBRATION_STANDARD_PERIOD 0x244e // write, exec. time: 1ms, during meas.: no
#define SCD41_GET_AUTOMATIC_SELF_CALIBRATION_STANDARD_PERIOD 0x234b // read, exec. time: 1ms, during meas.: no



// struct scd4xx_data {
//         uint16_t raw_sample;
//         int8_t co2_param[3];
//         int8_t temp_param[3];
//         int8_t rh_param[3];
// };

// struct scd4xx_config {
//         struct i2c_dt_spec bus;
// };

uint8_t scd4x_compute_crc(uint16_t value);

int scd4x_get_serial_number(const struct device *dev);

int scd4x_start_periodic_measurement(const struct device *dev);

int scd4x_read_measurement(const struct device *dev);
```
